## base_external/Config.in
```kconfig
source "$BR2_EXTERNAL_project_base_PATH/package/aesd-assignments/Config.in"
source "$BR2_EXTERNAL_project_base_PATH/package/bird-classifier/Config.in"
source "$BR2_EXTERNAL_project_base_PATH/package/python-script/Config.in"
source "$BR2_EXTERNAL_project_base_PATH/package/python-librosa/Config.in"
source "$BR2_EXTERNAL_project_base_PATH/package/python-numpy-prev-version/Config.in"
```

## base_external/package/bird-classifier/Config.in
```kconfig
config BR2_PACKAGE_BIRD_CLASSIFIER
	bool "bird-classifier"
	help
	  Kernel module for the AviAlert bird classification 
	  system to interface with RPi4 GPIO.
	  
	  https://github.com/cu-ecen-aeld/final-project-shrutikalyankar
```

## base_external/package/python-librosa/Config.in
```kconfig
config BR2_PACKAGE_PYTHON_LIBROSA
	bool "python-librosa"
	select BR2_PACKAGE_PYTHON3 # Add dependencies here (numpy, scipy, etc.)
	help
	  Librosa library for audio analysis.
```

## base_external/package/python-numpy-prev-version/Config.in
```kconfig
config BR2_PACKAGE_PYTHON_NUMPY_PREV_VERSION
	bool "python-numpy-prev-version"
	depends on BR2_PACKAGE_PYTHON3
	help
	  NumPy is the fundamental package for scientific computing
	  with Python.

	  https://numpy.org/
```

## base_external/package/python-script/Config.in
```kconfig
config BR2_PACKAGE_PYTHON_SCRIPT
	bool "python-script"
	help
	  Python scripts for microphone testing and bird classification 
	  integration.
```
